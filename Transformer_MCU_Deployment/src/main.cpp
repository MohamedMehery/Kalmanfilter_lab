/****************************************************************************
 * Transformer Predictive-Maintenance — MCU Inference Firmware
 * Target : Arduino Uno (ATmega328P) — also builds unmodified for ESP32 /
 *          STM32 Blue Pill by adding another [env:...] section to
 *          platformio.ini.
 *
 * MODE 0 = SELF_TEST : replays bundled test vectors (from the held-out
 *                       test split) through the on-device MLP and prints a
 *                       pass/fail report comparing against the reference
 *                       Python/TensorFlow predictions — proves the C
 *                       export is numerically equivalent to the PC/Colab
 *                       model before wiring up real sensors.
 * MODE 1 = LIVE       : reads analog sensor pins (oil/winding/ambient
 *                       temperature via NTC/LM35-style sensors, current via
 *                       ACS712-style sensors, etc.), builds the same
 *                       28-feature vector the Python pipeline used, and
 *                       runs the tiny MLP every SAMPLE_PERIOD_MS to flag
 *                       an incoming fault (LED + Serial alert).
 *
 * The exported model + scaler live in model/transformer_fault_model.h
 * (regenerated by ../Transformer_Predictive_Maintenance/src/export_to_mcu.py)
 * so this file never has to be edited when the model is retrained — only
 * the model/ folder needs to be re-copied.
 ****************************************************************************/
#define APP_MODE 0   // 0 = SELF_TEST (bundled vectors) | 1 = LIVE (real sensors)

#include <Arduino.h>
#include "tfm_inference.h"

#if APP_MODE == 0
  #include "test_vectors.h"
#endif

/* ── Pin map (LIVE mode only) ─────────────────────────────────────────── */
#define PIN_OTI_SENSOR   A0   // Oil Temperature Indicator   (analog, e.g. NTC/LM35)
#define PIN_ATI_SENSOR   A1   // Ambient Temperature Indicator
#define PIN_OLI_SENSOR   A2   // Oil Level Indicator (0-100%, e.g. potentiometer/float sensor)
#define PIN_IL1_SENSOR   A3   // Current Line 1 (e.g. ACS712)
#define PIN_IL2_SENSOR   A4   // Current Line 2
#define PIN_IL3_SENSOR   A5   // Current Line 3
#define LED_OK           7
#define LED_ALERT        8

#define SAMPLE_PERIOD_MS 2000UL

/* ── Feature order MUST match TFM feature_columns.txt exactly:
 * OTI, ATI, OLI, VL1, VL2, VL3, IL1, IL2, IL3, VL12, VL23, VL31, INUT,
 * OTI_roll_mean, OTI_roll_std, OTI_delta,
 * ATI_roll_mean, ATI_roll_std, ATI_delta,
 * IL1_roll_mean, IL1_roll_std, IL1_delta,
 * IL2_roll_mean, IL2_roll_std, IL2_delta,
 * IL3_roll_mean, IL3_roll_std, IL3_delta
 * ────────────────────────────────────────────────────────────────────── */
#define ROLL_WINDOW 4

struct RollingStat {
  float buf[ROLL_WINDOW];
  uint8_t count = 0;
  uint8_t head = 0;
  float last = 0.0f;
  bool hasLast = false;

  void push(float v) {
    buf[head] = v;
    head = (head + 1) % ROLL_WINDOW;
    if (count < ROLL_WINDOW) count++;
  }
  float mean() const {
    float s = 0.0f;
    for (uint8_t i = 0; i < count; i++) s += buf[i];
    return count ? s / count : 0.0f;
  }
  float stddev() const {
    if (count < 2) return 0.0f;
    float m = mean();
    float s = 0.0f;
    for (uint8_t i = 0; i < count; i++) { float d = buf[i] - m; s += d * d; }
    return sqrtf(s / count);
  }
  float delta(float v) {
    float d = hasLast ? (v - last) : 0.0f;
    last = v;
    hasLast = true;
    return d;
  }
};

RollingStat rollOTI, rollATI, rollIL1, rollIL2, rollIL3;

static float readVoltageLike(int pin) {
  // Placeholder scaling for a generic analog sensor -> engineering units.
  // Replace with the real sensor's calibration curve.
  return analogRead(pin) * (5.0f / 1023.0f) * 50.0f;  // arbitrary demo scale
}

static void buildFeatureVector(float *out) {
  float oti = readVoltageLike(PIN_OTI_SENSOR);
  float ati = readVoltageLike(PIN_ATI_SENSOR);
  float oli = analogRead(PIN_OLI_SENSOR) * (100.0f / 1023.0f);
  float il1 = readVoltageLike(PIN_IL1_SENSOR);
  float il2 = readVoltageLike(PIN_IL2_SENSOR);
  float il3 = readVoltageLike(PIN_IL3_SENSOR);

  // 3-phase voltage lines aren't wired on this demo board; set to typical
  // nominal values. On real hardware, replace with actual VT/CT readings.
  float vl1 = 240.0f, vl2 = 240.0f, vl3 = 240.0f;
  float vl12 = 415.0f, vl23 = 415.0f, vl31 = 415.0f;
  float inut = 0.0f;

  rollOTI.push(oti);
  rollATI.push(ati);
  rollIL1.push(il1);
  rollIL2.push(il2);
  rollIL3.push(il3);

  int i = 0;
  out[i++] = oti;
  out[i++] = ati;
  out[i++] = oli;
  out[i++] = vl1;
  out[i++] = vl2;
  out[i++] = vl3;
  out[i++] = il1;
  out[i++] = il2;
  out[i++] = il3;
  out[i++] = vl12;
  out[i++] = vl23;
  out[i++] = vl31;
  out[i++] = inut;
  out[i++] = rollOTI.mean();
  out[i++] = rollOTI.stddev();
  out[i++] = rollOTI.delta(oti);
  out[i++] = rollATI.mean();
  out[i++] = rollATI.stddev();
  out[i++] = rollATI.delta(ati);
  out[i++] = rollIL1.mean();
  out[i++] = rollIL1.stddev();
  out[i++] = rollIL1.delta(il1);
  out[i++] = rollIL2.mean();
  out[i++] = rollIL2.stddev();
  out[i++] = rollIL2.delta(il2);
  out[i++] = rollIL3.mean();
  out[i++] = rollIL3.stddev();
  out[i++] = rollIL3.delta(il3);
}

#if APP_MODE == 0
static void runSelfTest() {
  Serial.println(F("=== Transformer Fault MLP — on-device self-test ==="));
  Serial.print(F("Vectors: ")); Serial.println(TFM_N_TEST_VECTORS);

  int correct = 0;
  float max_abs_err = 0.0f;

  for (int v = 0; v < TFM_N_TEST_VECTORS; v++) {
    float x[TFM_N_INPUTS];
    for (int i = 0; i < TFM_N_INPUTS; i++) {
      x[i] = TFM_READ_FLOAT(&TFM_TEST_X[v * TFM_N_INPUTS + i]);
    }
    float p_device = tfm_predict_from_raw(x);
    float p_reference = TFM_READ_FLOAT(&TFM_TEST_Y_PROBA[v]);
    uint8_t y_true = TFM_READ_U8(&TFM_TEST_Y_LABEL[v]);

    uint8_t pred_device = p_device >= 0.5f ? 1 : 0;
    if (pred_device == y_true) correct++;
    float err = fabsf(p_device - p_reference);
    if (err > max_abs_err) max_abs_err = err;

    Serial.print(F("  [")); Serial.print(v); Serial.print(F("] device_p="));
    Serial.print(p_device, 4);
    Serial.print(F("  reference_p=")); Serial.print(p_reference, 4);
    Serial.print(F("  true_label=")); Serial.print((int)y_true);
    Serial.print(F("  pred=")); Serial.println((int)pred_device);
  }

  Serial.print(F("Accuracy on bundled vectors: "));
  Serial.print(correct); Serial.print(F("/")); Serial.println((int)TFM_N_TEST_VECTORS);
  Serial.print(F("Max |device_p - reference_p|: "));
  Serial.println(max_abs_err, 6);
  Serial.println(max_abs_err < 0.01f
                      ? F("PASS: device inference matches PC/Colab model.")
                      : F("WARNING: numerical mismatch — check export step."));
}
#endif

void setup() {
  Serial.begin(115200);
  delay(500);
  pinMode(LED_OK, OUTPUT);
  pinMode(LED_ALERT, OUTPUT);

  Serial.println(F("Transformer Predictive-Maintenance — MCU firmware boot"));
  Serial.print(F("Mode: "));
  Serial.println(APP_MODE == 0 ? F("SELF_TEST") : F("LIVE"));

#if APP_MODE == 0
  runSelfTest();
#endif
}

void loop() {
#if APP_MODE == 0
  // Nothing to do — self-test already ran once in setup().
  delay(1000);
#else
  static unsigned long lastSample = 0;
  unsigned long now = millis();
  if (now - lastSample >= SAMPLE_PERIOD_MS) {
    lastSample = now;

    float features[TFM_N_INPUTS];
    buildFeatureVector(features);
    float proba = tfm_predict_from_raw(features);
    bool alert = proba >= 0.5f;

    digitalWrite(LED_OK, alert ? LOW : HIGH);
    digitalWrite(LED_ALERT, alert ? HIGH : LOW);

    Serial.print(F("fault_probability=")); Serial.print(proba, 4);
    Serial.print(F("  alert=")); Serial.println(alert ? F("YES") : F("no"));
  }
#endif
}
